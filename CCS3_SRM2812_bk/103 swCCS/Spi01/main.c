
/*********************************************************************
**	实验目的:通过学习本实验来掌握DSP的SPI工作原理                   **
**	实验说明:SPI是一高速同步的串行输入输出口,它的通信速率和通信数据 **
**           长度都是可编程的,可以接收和发送16位的数据位,并且带有双 **
**           缓冲的.SPI的4个外部引脚由：从输出主输入(SPISOMI),
**	         从输入主输出（SPISIMO）,从发送使能（/SPISTE）,串行时钟 **
**           引脚(SPICLK)组成。主要硬件部分：DSP，74HC595（串入并出 **
**           的移位器),共阳数码管。SPIMOSI和SPICLK直接从DSP接到了   **
**           74HC595的SER和SRCLK，作为数据和时钟信号的输入，SPISTE引**
**           脚接到了74HC595的RCLK以控制其选通。                    **
**	实验结果:可看到数码管从0～F循环显示                             **
**********************************************************************/

#include "DSP28_Device.h"

void WriteLED(unsigned char data);					//送给数码管的数据函数

unsigned long int a;

Uint16	SpiCode[]={0x7E7E,0x2929,0x2c2c,0x6666,0xa4a4,0xa0a0,0x3e3e,0x2020,0x2424,0x2222,0xe0e0,0xb1b1,0x6868,0xa1a1,0xa3a3,0xffff,0xdfdf};

void main(void)
{   
    int k;
    
	/*初始化系统*/
	InitSysCtrl();
	
	/* 关中断 */
	DINT;
	IER = 0x0000;
	IFR = 0x0000;
	
	/* 初始化PIE控制寄存器 */
	InitPieCtrl();
	
	/* 初始化PIE参数表 */
	InitPieVectTable();	
	
	/* 初始化外设寄存器 */
	InitGpio();

	InitSpi();
   
	/*设置CPU*/
	
	EINT; // 开全局中断
	ERTM; // 开实时中断

	for(;;)
	 {  
	    for(k=0;k<16;k++)			//循环发送16个数据
      	{
      	   GpioDataRegs.GPFDAT.bit.GPIOF3=0; //输出低电平选中74HC595
      	   WriteLED(SpiCode[k]);	//发送数据函数
		   for(a=0;a<500000;a++);   //延时
        }
	 }
} 	

/****************************************************************************
*
*名    称：WriteLED()
*
*功    能：SPI发送数据
*
*入口参数：char data，需要发送的数据
*
*出口参数：无
*
****************************************************************************/
void WriteLED(unsigned char data)
{   
   if(Spi_TxReady() == 1)		//当检测到SPI发送准备信号致1时,开始发送数据
   {   
      SpiaRegs.SPITXBUF = data;	//把数据写如SPI发送缓冲区
   }

   while(Spi_TxReady()!=1);		//一直等待直到数据发送完成
   {
   }  
   
   GpioDataRegs.GPFDAT.bit.GPIOF3=1; //退出时关片选
}


//===========================================================================
// No more.
//===========================================================================
